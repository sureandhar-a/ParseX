AUTOSAR XML (schema 00046)
package /WarnPkg
  elements cluster=baudrate=500000:
    cluster NoBaud
      physical channel ch0
    ecu instance Lonely
    frame Empty: length=8
    frame NoLen: frame-pdu{pdu=/WarnPkg/NoLenPdu, start-position=0}
    pdu NoLenPdu: pdu-signal-mapping{signal=/WarnPkg/NoLengthSignal, start-position=0}
    pdu NoMap: length=8
    i signal NoLengthSignal
    system signal Stub
    signal group NoMembers
