AUTOSAR XML (schema 4-2-2)
package /L01/L02/L03/L04/L05/L06/L07/L08/L09/L10/L11/L12
  cluster DeepCluster: category=CAN, baudrate=500000
