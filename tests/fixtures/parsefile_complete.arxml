AUTOSAR XML (schema 00046)
package /Sys
  cluster CAN_Cluster: category=CAN, baudrate=500000
    physical channel can0
  ecu instance ECU_A: connected-channels=can0
    can controller CanCtrl_1
  frame Frame_1: length=8, transmitters=ECU_A
    frame pdu Frame_1_Pdu_1: pdu=Pdu_1, start-position=0
  pdu Pdu_1: length=8
    pdu signal mapping Pdu_1_Signal_1: signal=Signal_1, start-position=0, byte-order=big-endian
  system signal Signal_1: start-bit=0, bit-length=16, byte-order=big-endian, receivers=ECU_A
  signal group SignalGroup_1: members=Signal_1
