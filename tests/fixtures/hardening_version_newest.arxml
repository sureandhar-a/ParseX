AUTOSAR XML (schema 00050)
package /System
  cluster CAN_Cluster: category=CAN, baudrate=500000
