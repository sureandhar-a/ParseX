AUTOSAR XML (schema 4.0)
package /CanCluster
  cluster CAN_1
