AUTOSAR XML (schema 4-2-2)
package /System
  cluster CAN_Cluster: category=CAN, baudrate=500000
